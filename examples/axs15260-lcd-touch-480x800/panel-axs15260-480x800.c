/*
 * AXS15260 480x800 2-Lane MIPI-DSI Panel Driver for Raspberry Pi 5
 *
 * This example is from the open-source sharing by engineers of Yuying Optoelectronics (鱼鹰光电)
 * on Github.com/osptek. Welcome to provide improvement suggestions.
 *
 * 本例程来源于鱼鹰光电的工程师的开源分享 Github.com/osptek，欢迎提出改进意见
 */

#include <drm/drm_mipi_dsi.h>
#include <drm/drm_modes.h>
#include <drm/drm_panel.h>
#include <linux/backlight.h>
#include <linux/delay.h>
#include <linux/gpio/consumer.h>
#include <linux/module.h>
#include <linux/of.h>
#include <video/mipi_display.h>

struct power_on_timing {
	unsigned long post_reset;
	unsigned long reset_low;
	unsigned long after_reset;
	unsigned long slpout;
};

struct axs15260_desc {
	const struct drm_display_mode *mode;
	unsigned int lanes;
	unsigned long flags;
	enum mipi_dsi_pixel_format format;
	int (*init_sequence)(struct mipi_dsi_device *dsi);
	const struct power_on_timing *pwr_timing;
	bool do_sw_reset;
};

struct axs15260 {
	struct drm_panel panel;
	struct mipi_dsi_device *dsi;
	const struct axs15260_desc *desc;
	struct gpio_desc *reset;
	enum drm_panel_orientation orientation;
};

static inline struct axs15260 *to_axs15260(struct drm_panel *panel)
{
	return container_of(panel, struct axs15260, panel);
}

/* ==================== AXS15260 480x800 初始化序列 ==================== */
static int axs15260_480x800_init_sequence(struct mipi_dsi_device *dsi)
{
	struct mipi_dsi_multi_context ctx = { .dsi = dsi };

	mipi_dsi_dcs_write_seq_multi(&ctx, 0xBB, 0x00, 0x00, 0x00, 0x00, 0x00, 0x00, 0x5A, 0xA5);
	mipi_dsi_dcs_write_seq_multi(&ctx, 0xF8, 0x21, 0xA0);
	mipi_dsi_dcs_write_seq_multi(&ctx, 0xA0, 0x00, 0x10, 0x00, 0x02, 0x00, 0x00, 0x04, 0xFF, 0x00, 0x05, 0x3A, 0x3A, 0x00, 0x00, 0x00, 0x00, 0x00, 0x00, 0x00, 0x00, 0x00, 0x00, 0x00, 0x00, 0x00, 0x00, 0x00, 0x00, 0xA0);
	mipi_dsi_dcs_write_seq_multi(&ctx, 0xA1, 0x8F, 0xE5, 0x11, 0xAA, 0x55, 0x00, 0x02, 0x00, 0x00, 0x00, 0x01, 0x26, 0x26, 0x32, 0x92, 0x93, 0x13, 0x92, 0x90, 0x90, 0x90, 0x84);
	mipi_dsi_dcs_write_seq_multi(&ctx, 0xA2, 0x00, 0x06, 0x10, 0x1C, 0x12, 0x06, 0x14, 0x00, 0x00, 0x00, 0x00,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 0xFF, 0x00);
	mipi_dsi_dcs_write_seq_multi(&ctx, 0xA4, 0x85, 0x85, 0x92, 0x82, 0xAF, 0xAD, 0xAD, 0x80, 0x10, 0x30, 0x40, 0x40, 0x20, 0x50, 0x60, 0x53);
	mipi_dsi_dcs_write_seq_multi(&ctx, 0xB8, 0x03, 0x08, 0x08, 0x20, 0x00, 0x02, 0x50, 0x5E, 0x1F, 0x8F, 0x40, 0x00, 0x03, 0x00, 0x83, 0x90, 0x90, 0x90, 0x90, 0x90, 0x90, 0x90, 0x90, 0x90, 0x90, 0x90, 0x90, 0x90);
	mipi_dsi_dcs_write_seq_multi(&ctx, 0xB9, 0x64, 0x34, 0x78, 0x32, 0xAA, 0x55, 0xAA, 0x00, 0x00, 0x00, 0xF0, 0x00, 0x13, 0xC8, 0x00, 0x10, 0x27, 0xC8, 0x00, 0x64, 0x10, 0xFF, 0x14, 0x07, 0x1E, 0x0A, 0x00, 0x00, 0x00, 0x00);
	mipi_dsi_dcs_write_seq_multi(&ctx, 0xBA, 0x40, 0x80, 0x0E, 0x10, 0x0E, 0x10, 0x90, 0x13, 0x03, 0xFF, 0x04, 0x22, 0x00, 0x00, 0x00, 0x00, 0x00, 0x00, 0x00, 0x00, 0x00, 0x30);
	mipi_dsi_dcs_write_seq_multi(&ctx, 0xC1, 0x72, 0x04, 0x02, 0x02, 0x71, 0x05, 0x18, 0x00, 0x02, 0x00, 0x01, 0x01, 0x43, 0xFF, 0xFF, 0x7F, 0x4F, 0x52, 0x00, 0x4F, 0x52, 0x00, 0x54, 0x3B, 0x0B, 0x04, 0x06, 0xFF, 0xFF, 0x00);
	mipi_dsi_dcs_write_seq_multi(&ctx, 0xC3, 0x00, 0xC0);
	mipi_dsi_dcs_write_seq_multi(&ctx, 0xC4, 0x02, 0x02, 0xC0, 0x83, 0x00, 0x63, 0x00, 0x0C, 0x03, 0x0C, 0x01, 0x01, 0x03, 0x10, 0x3E, 0x06, 0x9D, 0x05, 0x03, 0x80, 0xFE, 0x10, 0x10, 0x00, 0x0A, 0x0A, 0x48, 0x48, 0x84, 0xA5);
	mipi_dsi_dcs_write_seq_multi(&ctx, 0xC5, 0x19, 0x19, 0x00, 0x3E, 0x30, 0x3E, 0x0D, 0x30, 0x30, 0x10, 0x88, 0x19, 0x19, 0x19, 0x19, 0x19, 0x19, 0x6B, 0x03, 0x10, 0x10, 0x10, 0x00);
	mipi_dsi_dcs_write_seq_multi(&ctx, 0xC6, 0x05, 0x0A, 0x05, 0x0A, 0xC0, 0xE0, 0x2E, 0x03, 0x12, 0x22, 0x12, 0x22, 0x01, 0x00, 0x00, 0x02, 0xC8, 0x22, 0xFA, 0xE8, 0x30, 0x64, 0x00, 0x08, 0x00, 0x09, 0xF0, 0x00, 0x00, 0xF0, 0x01);
	mipi_dsi_dcs_write_seq_multi(&ctx, 0xC7, 0x50, 0x10, 0x28, 0x00, 0xA2, 0x00, 0x4F, 0x00, 0x00, 0xFF, 0xA8,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 0x00, 0x00);
	mipi_dsi_dcs_write_seq_multi(&ctx, 0xCF, 0x3C, 0x1E, 0x88, 0x50, 0xFF, 0x18, 0x16, 0x18, 0x16, 0x0A, 0x8C, 0x3C, 0x69, 0x0E, 0x6E, 0x88, 0x0C, 0x0F, 0x22, 0x88, 0xAA, 0x55, 0x04, 0x04, 0x91, 0xA0, 0x30, 0x24, 0xBB, 0x01, 0x00);
	mipi_dsi_dcs_write_seq_multi(&ctx, 0xD0, 0x00, 0x00, 0x01, 0x24, 0x08, 0x05, 0x30, 0x01, 0xFF, 0x11, 0xC1,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 0x13, 0x12);
	mipi_dsi_dcs_write_seq_multi(&ctx, 0xD5, 0x40, 0x40, 0x92, 0x00, 0x79, 0x03, 0x1C, 0x7A, 0x06, 0x1C, 0x7A,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 0x30, 0x30);
	mipi_dsi_dcs_write_seq_multi(&ctx, 0xD6, 0x10, 0x32, 0x54, 0x76, 0x98, 0xBA, 0xDC, 0xFE, 0x02, 0x00, 0x01,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 0x00, 0x20);
	mipi_dsi_dcs_write_seq_multi(&ctx, 0xD7, 0x1F, 0x1F, 0x1B, 0x01, 0x18, 0x11, 0x13, 0x15, 0x17, 0x09, 0x0B, 0x0D, 0x0F, 0x18, 0x1F, 0x19, 0x1F);
	mipi_dsi_dcs_write_seq_multi(&ctx, 0xD8, 0x1F, 0x1F, 0x1A, 0x00, 0x18, 0x10, 0x12, 0x14, 0x16, 0x08, 0x0A, 0x0C, 0x0E, 0x18, 0x1F, 0x19, 0x1F);
	mipi_dsi_dcs_write_seq_multi(&ctx, 0xDF, 0x00, 0x00, 0x5B, 0xAB, 0xBB, 0x2B, 0x28);
	mipi_dsi_dcs_write_seq_multi(&ctx, 0xE0, 0x00, 0x07, 0x0F, 0x16, 0x19, 0x1E, 0x20, 0x20, 0x48, 0x5E, 0x73, 0x76, 0x84, 0x98, 0xA0, 0xA7, 0xB7, 0xBD, 0xBB, 0xC9, 0xD7, 0x6A, 0x67, 0x69, 0x6C, 0x6E, 0x6E, 0x72, 0x70, 0x33, 0x35, 0x01);
	mipi_dsi_dcs_write_seq_multi(&ctx, 0xE1, 0x00, 0x07, 0x0F, 0x16, 0x19, 0x1E, 0x20, 0x20, 0x48, 0x5E, 0x73,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 0xD6, 0x33);
	mipi_dsi_dcs_write_seq_multi(&ctx, 0xE7, 0x20, 0x03, 0xE0, 0x01, 0x20, 0x03, 0xE0, 0x01, 0xFE, 0x0F, 0x00, 0x08, 0xCC, 0x03);
	mipi_dsi_dcs_write_seq_multi(&ctx, 0xE8, 0xA9, 0x05, 0x00, 0x00, 0x00, 0x00, 0x01, 0x01, 0x22, 0x30, 0x0D, 0x00, 0xCF, 0x20, 0x00, 0xFF, 0x40, 0x00, 0x00, 0x00, 0x00, 0x00);
	mipi_dsi_dcs_write_seq_multi(&ctx, 0xE9, 0x00, 0x2B, 0x02, 0x00, 0x02, 0x03, 0x00, 0xB2, 0x10, 0x0E, 0x60, 0x14, 0x05, 0x81, 0x01, 0x06, 0x05, 0x00, 0x80, 0x07, 0x08, 0x07);
	
	mipi_dsi_dcs_write_seq_multi(&ctx, 0xBB, 0x00, 0x00, 0x00, 0x00, 0x00, 0x00, 0x00, 0x00);
	mipi_dsi_msleep(&ctx, 50);

	/* 退出睡眠模式 (Sleep Out) 并延时 200ms */
	mipi_dsi_dcs_write_seq_multi(&ctx, 0x11);
	mipi_dsi_msleep(&ctx, 200);

	/* 开启显示 (Display ON) 并延时 330ms */
	mipi_dsi_dcs_write_seq_multi(&ctx, 0x29);
	mipi_dsi_msleep(&ctx, 330);

	return ctx.accum_err;
}

static int axs15260_prepare(struct drm_panel *panel)
{
	struct axs15260 *axs15260 = to_axs15260(panel);
	struct mipi_dsi_multi_context ctx = { .dsi = axs15260->dsi };

	if (axs15260->reset) {
		gpiod_set_value_cansleep(axs15260->reset, 1);
		msleep(axs15260->desc->pwr_timing->post_reset);
		gpiod_set_value_cansleep(axs15260->reset, 0);
		msleep(axs15260->desc->pwr_timing->reset_low);
		gpiod_set_value_cansleep(axs15260->reset, 1);
		msleep(axs15260->desc->pwr_timing->after_reset);
	}

	if (axs15260->desc->do_sw_reset) {
		mipi_dsi_dcs_soft_reset_multi(&ctx);
		msleep(axs15260->desc->pwr_timing->after_reset);
	}

	if (axs15260->desc->init_sequence) {
		int ret = axs15260->desc->init_sequence(axs15260->dsi);
		if (ret)
			return ret;
	}

	return ctx.accum_err;
}

static int axs15260_enable(struct drm_panel *panel)
{
	struct mipi_dsi_multi_context ctx = { .dsi = to_mipi_dsi_device(panel->dev) };
	mipi_dsi_dcs_set_display_on_multi(&ctx);
	return ctx.accum_err;
}

static int axs15260_disable(struct drm_panel *panel)
{
	struct mipi_dsi_multi_context ctx = { .dsi = to_mipi_dsi_device(panel->dev) };
	mipi_dsi_dcs_set_display_off_multi(&ctx);
	return ctx.accum_err;
}

static int axs15260_unprepare(struct drm_panel *panel)
{
	struct axs15260 *axs15260 = to_axs15260(panel);
	struct mipi_dsi_multi_context ctx = { .dsi = axs15260->dsi };

	mipi_dsi_dcs_enter_sleep_mode_multi(&ctx);
	if (axs15260->reset)
		gpiod_set_value_cansleep(axs15260->reset, 0);

	return ctx.accum_err;
}

static int axs15260_get_modes(struct drm_panel *panel, struct drm_connector *connector)
{
	struct axs15260 *axs15260 = to_axs15260(panel);
	struct drm_display_mode *mode;

	mode = drm_mode_duplicate(connector->dev, axs15260->desc->mode);
	if (!mode)
		return -ENOMEM;

	drm_mode_set_name(mode);
	drm_mode_probed_add(connector, mode);

	connector->display_info.width_mm = mode->width_mm;
	connector->display_info.height_mm = mode->height_mm;

	drm_connector_set_orientation_from_panel(connector, panel);
	return 1;
}

static enum drm_panel_orientation axs15260_get_orientation(struct drm_panel *panel)
{
	return to_axs15260(panel)->orientation;
}

static const struct drm_panel_funcs axs15260_funcs = {
	.prepare = axs15260_prepare,
	.enable = axs15260_enable,
	.disable = axs15260_disable,
	.unprepare = axs15260_unprepare,
	.get_modes = axs15260_get_modes,
	.get_orientation = axs15260_get_orientation,
};

/* ==================== 3.97寸 480x800 DPI 时序与物理尺寸配置 ==================== */
static const struct drm_display_mode axs15260_mode = {
	/* 35.7 MHz Pixel Clock */
	.clock = 35700,

	/* 水平时序 (Horizontal Timing) */
	.hdisplay = 480,
	.hsync_start = 480 + 70,		/* HFP: 70 */
	.hsync_end   = 480 + 70 + 10,		/* HSW: 10 */
	.htotal      = 480 + 70 + 10 + 70,	/* HBP: 70 (HTOTAL = 630) */

	/* 垂直时序 (Vertical Timing) */
	.vdisplay = 800,
	.vsync_start = 800 + 125,		/* VFP: 125 */
	.vsync_end   = 800 + 125 + 2,		/* VSW: 2 */
	.vtotal      = 800 + 125 + 2 + 20,	/* VBP: 20 (VTOTAL = 947) */

	/* 3.97 寸 480x800 屏幕标准显示区域物理尺寸 (单位: mm) */
	.width_mm = 52,
	.height_mm = 86,

	.type = DRM_MODE_TYPE_DRIVER | DRM_MODE_TYPE_PREFERRED,
};

static const struct power_on_timing axs15260_pwr_timing = {
	.post_reset = 10,
	.reset_low = 10,
	.after_reset = 50,
	.slpout = 120,
};

static const struct axs15260_desc axs15260_desc = {
	.mode = &axs15260_mode,
	.lanes = 2, /* AXS15260 MIPI-DSI 为 2 Lane */
	.flags = MIPI_DSI_MODE_VIDEO | MIPI_DSI_MODE_VIDEO_BURST | MIPI_DSI_MODE_LPM,
	.format = MIPI_DSI_FMT_RGB888,
	.init_sequence = axs15260_480x800_init_sequence,
	.pwr_timing = &axs15260_pwr_timing,
	.do_sw_reset = false,
};

static int axs15260_probe(struct mipi_dsi_device *dsi)
{
	struct axs15260 *axs15260;
	const struct axs15260_desc *desc;
	int ret;

	axs15260 = devm_kzalloc(&dsi->dev, sizeof(*axs15260), GFP_KERNEL);
	if (!axs15260)
		return -ENOMEM;

	desc = of_device_get_match_data(&dsi->dev);
	dsi->mode_flags = desc->flags;
	dsi->format = desc->format;
	dsi->lanes = desc->lanes;

	axs15260->panel.prepare_prev_first = true;
	axs15260->reset = devm_gpiod_get_optional(&dsi->dev, "reset", GPIOD_OUT_HIGH);
	if (IS_ERR(axs15260->reset)) {
		dev_err(&dsi->dev, "Failed to get reset GPIO\n");
		return PTR_ERR(axs15260->reset);
	}

	ret = of_drm_get_panel_orientation(dsi->dev.of_node, &axs15260->orientation);
	if (ret < 0)
		axs15260->orientation = DRM_MODE_PANEL_ORIENTATION_NORMAL;

	drm_panel_init(&axs15260->panel, &dsi->dev, &axs15260_funcs, DRM_MODE_CONNECTOR_DSI);

	ret = drm_panel_of_backlight(&axs15260->panel);
	if (ret)
		return ret;

	drm_panel_add(&axs15260->panel);

	mipi_dsi_set_drvdata(dsi, axs15260);
	axs15260->dsi = dsi;
	axs15260->desc = desc;

	ret = mipi_dsi_attach(dsi);
	if (ret)
		drm_panel_remove(&axs15260->panel);

	return ret;
}

static void axs15260_remove(struct mipi_dsi_device *dsi)
{
	struct axs15260 *axs15260 = mipi_dsi_get_drvdata(dsi);

	mipi_dsi_detach(dsi);
	drm_panel_remove(&axs15260->panel);
}

static const struct of_device_id axs15260_of_match[] = {
	{ .compatible = "axs,axs15260-480x800", .data = &axs15260_desc },
	{ }
};
MODULE_DEVICE_TABLE(of, axs15260_of_match);

static struct mipi_dsi_driver axs15260_driver = {
	.probe = axs15260_probe,
	.remove = axs15260_remove,
	.driver = {
		.name = "panel-axs15260-480x800",
		.of_match_table = axs15260_of_match,
	},
};
module_mipi_dsi_driver(axs15260_driver);

MODULE_AUTHOR("Adapted for AiXiangSheng AXS15260 480x800 2-Lane MIPI-DSI");
MODULE_DESCRIPTION("AiXiangSheng AXS15260 480x800 2-Lane MIPI-DSI Panel Driver");
MODULE_LICENSE("GPL");
